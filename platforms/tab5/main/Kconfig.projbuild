## platforms/tab5/main/Kconfig.projbuild
```kconfig
menu "Tab5X test options"

choice TAB5X_BOOT_MODE
    prompt "Tab5X boot operating mode"
    default TAB5X_BOOT_MODE_NORMAL
    help
        Select the normal product application or the isolated MP3 playback
        diagnostic entry. The two modes are mutually exclusive.

config TAB5X_BOOT_MODE_NORMAL
    bool "Normal application mode"
    help
        Start the complete Tab5X application, including the UI and normal
        peripheral services.

config TAB5X_BOOT_MODE_MP3_ISOLATED
    bool "Isolated MP3 playback diagnostic mode"
    depends on AUDIO_PLAYER_ENABLE_MP3
    help
        Start only the board I2C, speaker enable path, codec, audio player,
        MP3 decoder, and I2S output. Normal UI and application tasks are not
        compiled into the main component in this mode.

endchoice

config TAB5X_BOOT_MP3_REPEAT
    bool "Repeat isolated MP3 playback"
    depends on TAB5X_BOOT_MODE_MP3_ISOLATED
    default n
    help
        Recreate the audio player and replay the embedded canon_in_d.mp3
        after a one-second pause. This is useful for observing heap leaks or
        fragmentation across repeated player lifecycles.

config TAB5X_BOOT_MP3_VOLUME
    int "Isolated MP3 playback volume"
    depends on TAB5X_BOOT_MODE_MP3_ISOLATED
    range 0 100
    default 80
    help
        Speaker volume used by the isolated MP3 diagnostic mode.

config TAB5X_DRIVER_SMOKE_TEST
    bool "Run camera and audio driver smoke tests at boot"
    depends on TAB5X_BOOT_MODE_NORMAL
    default n
    help
        After normal startup, run one audio record/playback cycle and capture
        camera frames for five seconds. This validates driver calls and data
        movement only; it does not assess acoustic or image quality.

config TAB5X_AUDIO_I2S_DIAGNOSTICS
    bool "Enable audio I2S transfer diagnostics"
    default n
    help
        Collect and print board-level audio TX full-write, I2S timing, frame-gap,
        retry/error, and internal/DMA/PSRAM heap statistics. The full-write
        behavior remains active when this option is disabled; only the added
        diagnostic counters and periodic logs are removed.

config TAB5X_LVGL_TASK_DIAGNOSTICS
    bool "Enable LVGL task checkpoint diagnostics"
    depends on TAB5X_BOOT_MODE_NORMAL
    default n
    help
        Count the LVGL task and internal A-AG checkpoints around the LVGL
        mutex, timer callbacks, display refresh, PPA rotation, LCD transfer,
        flush wait/ready handling, touch/USB input callbacks, and camera PPA.
        A low-priority diagnostic task prints the counters, last LVGL timer and
        callback addresses, and last LCD draw result every five seconds. Enable
        this option only while diagnosing UI freezes because it adds periodic
        logging and a small diagnostic task.

config TAB5X_LVGL_DISPLAY_ROTATION_USE_PPA
    bool "Use PPA for LVGL display rotation"
    depends on TAB5X_BOOT_MODE_NORMAL
    default y
    help
        Use the blocking PPA path for LVGL software display rotation. When
        disabled, LVGL software rotation remains enabled and lv_draw_sw_rotate()
        is used instead. This option changes only the display rotation backend;
        it does not disable sw_rotate.

config TAB5X_MP3_DECODE_DIAGNOSTICS
    bool "Enable MP3 decode diagnostics"
    depends on AUDIO_PLAYER_ENABLE_MP3
    default n
    help
        Collect and print MP3 input refill, sync search, Helix decode, decoder
        call-gap, output-byte, error, heap, and buffer-memory-location statistics.
        A first-frame report and cumulative reports at about five-second intervals
        are emitted. Disable this option for normal operation to remove the timing
        and diagnostic log overhead.

endmenu
```

## platforms/tab5/sdkconfig.defaults
```kconfig
CONFIG_IDF_TARGET="esp32p4"
CONFIG_ESP32P4_REV_MIN_301=y
CONFIG_ESPTOOLPY_FLASHMODE_QIO=y
CONFIG_ESPTOOLPY_FLASHSIZE_16MB=y
CONFIG_PARTITION_TABLE_CUSTOM=y
CONFIG_BOOTLOADER_LOG_LEVEL_WARN=y
CONFIG_COMPILER_OPTIMIZATION_PERF=y
CONFIG_SPIRAM=y
CONFIG_SPIRAM_SPEED_200M=y
CONFIG_SPIRAM_XIP_FROM_PSRAM=y
CONFIG_CACHE_L2_CACHE_256KB=y
CONFIG_CACHE_L2_CACHE_LINE_128B=y
CONFIG_CODEC_I2C_BACKWARD_COMPATIBLE=n

# Tab5 and Tab5X use the SC202CS MIPI-CSI camera at 1280x720 RAW8.
CONFIG_CAMERA_SC202CS=y
CONFIG_CAMERA_SC202CS_AUTO_DETECT=y
CONFIG_CAMERA_SC202CS_AUTO_DETECT_MIPI_INTERFACE_SENSOR=y
CONFIG_CAMERA_SC202CS_MIPI_RAW8_1280x720_30FPS=y
CONFIG_CAMERA_SC202CS_MIPI_IF_FORMAT_INDEX_DAFAULT=0
CONFIG_CAMERA_SC202CS_ABSOLUTE_GAIN_LIMIT=63008
CONFIG_CAMERA_SC202CS_DIG_GAIN_PRIORITY=y

# Tab5 ESP32-C6 Wi-Fi module uses the P4 SDIO2 signals on GPIO8-GPIO13.
CONFIG_ESP_HOSTED_SDIO_RESET_ACTIVE_HIGH=y
CONFIG_ESP_HOSTED_SDIO_SLOT_1=y
CONFIG_ESP_HOSTED_PRIV_SDIO_PIN_CMD_SLOT_1=13
CONFIG_ESP_HOSTED_PRIV_SDIO_PIN_CLK_SLOT_1=12
CONFIG_ESP_HOSTED_PRIV_SDIO_PIN_D0_SLOT_1=11
CONFIG_ESP_HOSTED_PRIV_SDIO_PIN_D1_4BIT_BUS_SLOT_1=10
CONFIG_ESP_HOSTED_PRIV_SDIO_PIN_D2_4BIT_BUS_SLOT_1=9
CONFIG_ESP_HOSTED_PRIV_SDIO_PIN_D3_4BIT_BUS_SLOT_1=8
CONFIG_ESP_HOSTED_SDIO_GPIO_RESET_SLAVE=15

CONFIG_FREERTOS_HZ=1000
CONFIG_FREERTOS_VTASKLIST_INCLUDE_COREID=y
CONFIG_FREERTOS_GENERATE_RUN_TIME_STATS=y
CONFIG_ESP_BROOKESIA_MEMORY_USE_CUSTOM=y
CONFIG_LV_COLOR_SCREEN_TRANSP=y
CONFIG_LV_MEM_CUSTOM=y
CONFIG_LV_MEMCPY_MEMSET_STD=y
CONFIG_LV_DISP_DEF_REFR_PERIOD=25
CONFIG_LV_USE_LOG=y
CONFIG_LV_LOG_PRINTF=y
CONFIG_LV_USE_PERF_MONITOR=y
CONFIG_LV_ATTRIBUTE_FAST_MEM_USE_IRAM=y
CONFIG_LV_FONT_MONTSERRAT_8=y
CONFIG_LV_FONT_MONTSERRAT_10=y
CONFIG_LV_FONT_MONTSERRAT_12=y
CONFIG_LV_FONT_MONTSERRAT_16=y
CONFIG_LV_FONT_MONTSERRAT_18=y
CONFIG_LV_FONT_MONTSERRAT_20=y
CONFIG_LV_FONT_MONTSERRAT_22=y
CONFIG_LV_FONT_MONTSERRAT_24=y
CONFIG_LV_FONT_MONTSERRAT_26=y
CONFIG_LV_FONT_MONTSERRAT_28=y
CONFIG_LV_FONT_MONTSERRAT_30=y
CONFIG_LV_FONT_MONTSERRAT_32=y
CONFIG_LV_FONT_MONTSERRAT_34=y
CONFIG_LV_FONT_MONTSERRAT_36=y
CONFIG_LV_FONT_MONTSERRAT_38=y
CONFIG_LV_FONT_MONTSERRAT_40=y
CONFIG_LV_FONT_MONTSERRAT_42=y
CONFIG_LV_FONT_MONTSERRAT_44=y
CONFIG_LV_FONT_FMT_TXT_LARGE=y
CONFIG_LV_USE_FONT_COMPRESSED=y
CONFIG_LV_USE_DEMO_BENCHMARK=y
CONFIG_IDF_EXPERIMENTAL_FEATURES=y
CONFIG_ESP_VIDEO_ENABLE_ISP_PIPELINE_CONTROLLER=y
```
